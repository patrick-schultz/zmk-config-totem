## config/west.yml
```yaml
manifest:
  remotes:
    - name: zmkfirmware
      url-base: https://github.com/zmkfirmware
    - name: urob
      url-base: https://github.com/urob
    - name: patrick-schultz
      url-base: https://github.com/patrick-schultz
  projects:
    - name: zmk
      remote: urob
      revision: v0.2+fix-child-nodes
      import: app/west.yml
    - name: zmk-helpers
      remote: urob
      revision: v0.2
    - name: zmk-auto-layer
      remote: urob
      revision: v0.2
    - name: zmk-adaptive-key
      remote: urob
      revision: v0.2
    - name: zmk-tri-state
      remote: urob
      revision: v0.2
  self:
    path: config
```
